/*
 * Jackpot Japan DCM Battery parameters device tree file
 *
 * Copyright (C) 2018 Samsung Electronics, Inc.
 *
 * This program is free software; you can redistribute it and/or
 * modify it under the terms of the GNU General Public License
 * as published by the Free Software Foundation; either version 2
 * of the License, or (at your option) any later version.
 *
 * This program is distributed in the hope that it will be useful,
 * but WITHOUT ANY WARRANTY; without even the implied warranty of
 * MERCHANTABILITY or FITNESS FOR A PARTICULAR PURPOSE.  See the
 * GNU General Public License for more details.
 *
 * You should have received a copy of the GNU General Public License
 * along with this program. If not, see <http://www.gnu.org/licenses/>.
 *
 */

/ {
	battery_params {
			battery,cycles_to_asoc_mapping = <
							0 80
							1101 50
							1801 49
							>;
	};

	battery {
		battery,fg_cycle_check_value = <1100>;
		battery,max_input_voltage = <5000>; /* mV */
	};
};
