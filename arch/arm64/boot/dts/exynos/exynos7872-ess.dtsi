/*
 * SAMSUNG EXYNOS7872 SoC device tree source
 *
 * Copyright (c) 2017 Samsung Electronics Co., Ltd.
 *		http://www.samsung.com
 *
 * SAMSUNG EXYNOS7872 SoC device nodes are listed in this file.
 * EXYNOS7872 based board files can include this file and provide
 * values for board specfic bindings.
 *
 * This program is free software; you can redistribute it and/or modify
 * it under the terms of the GNU General Public License version 2 as
 * published by the Free Software Foundation.
 */

/ {
	exynos-snapshot {
		compatible = "samsung,exynos-snapshot";
		dump-info@0x0 {
			sfr-dump-list = "sfr-for-example";
			#address-cells = <1>;
			#size-cells = <1>;

			/* This node is just example */
			sfr-for-example {
				reg = <0x10040000 0x1000>;
				addr = <0x10040100 0x10040104 0x10040108 0xFFFFFFFF>;
			};
		};
	};
};
