/*
 * SAMSUNG UNIVERSAL7885 board device tree source
 *
 * Copyright (c) 2013 Samsung Electronics Co., Ltd.
 *		http://www.samsung.com
 *
 * This program is free software; you can redistribute it and/or modify
 * it under the terms of the GNU General Public License version 2 as
 * published by the Free Software Foundation.
 */

/dts-v1/;
#include "exynos7904-m30lte_common.dtsi"
#include "exynos7904-m30lte_swa_open_gpio_04.dtsi"
#include "exynos7904-m30lte_fingerprint-sensor_00.dtsi"
#include "exynos7904-m30lte-sensor-r01.dtsi"

/ {
	model = "Samsung M30LTE SWA OPEN rev03 board based on EXYNOS7904";
	model_info-chip = <7885>;
	model_info-platform = "android";
	model_info-subtype = "samsung";
	model_info-hw_rev = <4>;
	model_info-hw_rev_end = <255>;
	compatible = "samsung, M30 SWA OPEN rev03", "samsung,Universal7904";

	 /* USIM DETECTION FOR CP */
	usim_det {
		pinctrl-names = "default";
		pinctrl-0 = <&sim0_det_gpio>;
		mif,num_of_usim_det = <1>;
		mif,usim-det0-gpio = <&gpa2 6 0>;
	};

	i2c_4:i2c@13870000 {
		mms_ts@48 {
			melfas,fw_name = "tsp_melfas/mss100_m30.fw";
			melfas,fw_name_old = "tsp_melfas/mss100_m30_old.fw";
		};
	};
};

